// SPDX-License-Identifier: BSD-3-Clause

/dts-v1/;
/plugin/;

#include "kerap-iot-audio-retroid-pocket-duo.dtsi"

/ {
	model = "Retroid Pocket Duo Audio";
	compatible = "qcom,kera-mtp", "qcom,kera", "qcom,kerap-mtp", "qcom,kerap",
			"qcom,mtp", "qcom,kera-qmb", "qcom,kerap-qna";
	qcom,msm-id = <686 0x10000>, <659 0x10000>, <720 0x10000>,
			<721 0x10000>, <731 0x10000>, <732 0x10000>;
	qcom,board-id = <0x10008 1>;
};
