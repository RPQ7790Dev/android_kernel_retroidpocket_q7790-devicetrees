#include "../qcom/kera-mtp.dtsi"
#include "../qcom/kera_ufs2.dtsi"
#include "../qcom/kera-pm7550ba.dtsi"
#include "../qcom/wlan/kera-wcn7750.dtsi"
#include "../qcom/bt/kera-wcn7750-bt.dtsi"

#include "camera/kerap-iot-moorechip-camera.dtsi"
#include "peripherals/kerap-iot-moorechip-peripherals.dtsi"
#include "rpmh/kerap-iot-moorechip-rpmh.dtsi"
#include "thermal/kerap-iot-moorechip-thermal.dtsi"
